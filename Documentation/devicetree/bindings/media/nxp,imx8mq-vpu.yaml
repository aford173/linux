## Documentation/devicetree/bindings/media/nxp,imx8mq-vpu.yaml
```yaml
# SPDX-License-Identifier: (GPL-2.0 OR BSD-2-Clause)

%YAML 1.2
---
$id: "http://devicetree.org/schemas/media/nxp,imx8mq-vpu.yaml#"
$schema: "http://devicetree.org/meta-schemas/core.yaml#"

title: Hantro G1/G2 VPU codecs implemented on i.MX8MQ SoCs

maintainers:
  - Philipp Zabel <p.zabel@pengutronix.de>

description:
  Hantro G1/G2 video decode accelerators present on i.MX8MQ SoCs.

properties:
  compatible:
    oneOf:
      - const: nxp,imx8mq-vpu
        deprecated: true
      - const: nxp,imx8mq-vpu-g1
      - const: nxp,imx8mq-vpu-g2

  reg:
    minItems: 1
    maxItems: 3

  reg-names:
    minItems: 1
    items:
      - const: g1
      - const: g2
      - const: ctrl

  interrupts:
    minItems: 1
    maxItems: 2

  interrupt-names:
    minItems: 1
    items:
      - const: g1
      - const: g2

  clocks:
    minItems: 1
    maxItems: 3

  clock-names:
    minItems: 1
    items:
      - const: g1
      - const: g2
      - const: bus

  power-domains:
    maxItems: 1

required:
  - compatible
  - reg
  - reg-names
  - interrupts
  - interrupt-names
  - clocks
  - clock-names

additionalProperties: false

examples:
  # Device node example backwards compatibility
  - |
    #include <dt-bindings/clock/imx8mq-clock.h>
    #include <dt-bindings/interrupt-controller/arm-gic.h>

    vpu: video-codec@38300000 {
        compatible = "nxp,imx8mq-vpu";
        reg = <0x38300000 0x10000>,
              <0x38310000 0x10000>,
              <0x38320000 0x10000>;
        reg-names = "g1", "g2", "ctrl";
        interrupts = <GIC_SPI 7 IRQ_TYPE_LEVEL_HIGH>,
                     <GIC_SPI 8 IRQ_TYPE_LEVEL_HIGH>;
        interrupt-names = "g1", "g2";
        clocks = <&clk IMX8MQ_CLK_VPU_G1_ROOT>,
                 <&clk IMX8MQ_CLK_VPU_G2_ROOT>,
                 <&clk IMX8MQ_CLK_VPU_DEC_ROOT>;
        clock-names = "g1", "g2", "bus";
        power-domains = <&pgc_vpu>;
    };

  # VPU G1 with vpu-blk-ctrl
  - |
    #include <dt-bindings/clock/imx8mq-clock.h>
    #include <dt-bindings/power/imx8mq-power.h>
    #include <dt-bindings/interrupt-controller/arm-gic.h>

    vpu_g1: video-codec@38300000 {
        compatible = "nxp,imx8mq-vpu-g1";
        reg = <0x38300000 0x10000>;
        reg-names "g1";
        interrupts = <GIC_SPI 7 IRQ_TYPE_LEVEL_HIGH>;
        interrupt-names = "g1";
        clocks = <&clk IMX8MQ_CLK_VPU_G1_ROOT>;
        clock-names = "g1";
        power-domains = <&vpu_blk_ctrl IMX8MQ_VPUBLK_PD_G1>;
    };

  # VPU G2 with vpu-blk-ctrl
  - |
    #include <dt-bindings/clock/imx8mq-clock.h>
    #include <dt-bindings/power/imx8mq-power.h>
    #include <dt-bindings/interrupt-controller/arm-gic.h>

    vpu_g2: video-codec@38310000 {
        compatible = "nxp,imx8mq-vpu-g2";
        reg = <0x38310000 0x10000>;
        reg-names "g2";
        interrupts = <GIC_SPI 8 IRQ_TYPE_LEVEL_HIGH>;
        interrupt-names = "g2";
        clocks = <&clk IMX8MQ_CLK_VPU_G2_ROOT>;
        clock-names = "g2";
        power-domains = <&vpu_blk_ctrl IMX8MQ_VPUBLK_PD_G2>;
    };
```

## Documentation/devicetree/bindings/reset/ti,am3517-ip-sw-reset.yaml
```yaml
# SPDX-License-Identifier: (GPL-2.0-only OR BSD-2-Clause)
%YAML 1.2
---
$id: http://devicetree.org/schemas/reset/ti,am3517-ip-sw-reset.yaml#
$schema: http://devicetree.org/meta-schemas/core.yaml#

title: TI AM3517 IP SW Reset

maintainers:
  - Adam Ford <aford173@gmail.com>

description: |
  The AM3517-IP-SW reset controller can be used to a few select
  peripherals:
  USB20OTGSS_SW_RST, CPGMACSS_SW_RST, VPFE_VBUSP_SW_RST,
  HECC_SW_RST, and VPFE_PCLK_SW_RST.
  Device nodes that need access to reset lines should
  specify them as a reset phandle in their corresponding node.

properties:
  compatible:
    const: ti,am35xx-ip_sw_reset

  reg:
    maxItems: 1

  interrupts:
    maxItems: 1

  '#reset-cells':
    const: 1

required:
  - compatible
  - reg
  - '#reset-cells'

additionalProperties: false

examples:
  - |
    reset-controller@30390000 {
        compatible = "ti,am35xx-ip_sw_reset";
        reg = <0x48002598 0x4>;
        #reset-cells = <1>;
    };
```
